## config/boards/shields/ken/Kconfig.defconfig
```kconfig
if SHIELD_ken_LEFT

config ZMK_KEYBOARD_NAME
        default "ken"

config ZMK_SPLIT_ROLE_CENTRAL
        default y

endif

if SHIELD_ken_LEFT || SHIELD_ken_RIGHT

config ZMK_SPLIT
        default y

endif
```

## config/boards/shields/ken/Kconfig.shield
```kconfig
config SHIELD_ken_LEFT
        def_bool $(shields_list_contains,ken_left)

config SHIELD_ken_RIGHT
        def_bool $(shields_list_contains,ken_right)
```

## config/boards/shields/test1/Kconfig.defconfig
```kconfig
# Copyright (c) 2023 The ZMK Contributors
# SPDX-License-Identifier: MIT

if SHIELD_test1_LEFT

config ZMK_KEYBOARD_NAME
    default "ken_kb"

config ZMK_SPLIT_ROLE_CENTRAL
    default y

endif

if SHIELD_test1_LEFT || SHIELD_test1_RIGHT

config ZMK_SPLIT
    default y


endif
```
